// SPDX-License-Identifier: GPL-2.0-only OR MIT

#include "an7581-nokia_xg-040g-md-common.dtsi"
#include "an758x-nokia_xg-040g-tcboot-parts.dtsi"

/ {
	model = "Nokia XG-040G-MD (tcboot)";
	compatible = "nokia,xg-040g-md-tcboot", "airoha,an7581",
		     "airoha,en7581";
};

/*
 * 共用 dtsi 经 nvmem 从 ubi 的 ri 卷读取原厂 MAC，但该卷不是镜像的一部分，
 * 需刷机时用原厂 ri 分区的备份手工创建。卷不存在时 nvmem provider 永不注册，
 * of_get_ethdev_address() 返回 -EPROBE_DEFER，而驱动对这个错误码是直接
 * return 的（不会退化为随机 MAC），airoha_eth 与其下游的 DSA 交换机就会永久
 * 停在 deferred probe，整机无网络且日志里没有任何线索：
 *
 *	mt7530-mmio 1fb58000.switch: Failed to register DSA switch: -517
 *	platform 1fb58000.switch: deferred probe pending: (reason unknown)
 *	platform 1fb50000.ethernet: deferred probe pending: (reason unknown)
 *
 * 因此本变体去掉该依赖，改由 base-files/lib/preinit/90_xg-040g-md_mac 在
 * 用户态读取 ri 卷。行为等价，但缺卷时只是退回随机 MAC，不会锁死网络。
 */
&gdm1 {
	/delete-property/ nvmem-cell-names;
	/delete-property/ nvmem-cells;
};

&gdm4 {
	/delete-property/ nvmem-cell-names;
	/delete-property/ nvmem-cells;
};

/*
 * 第三方 tcboot 带的 ATF 没有实现 Airoha 的 AVS SIP 调用（0x82000301），
 * mainline 的 airoha-cpu-pmdomain 只有这一条路，SMC 返回 0 导致时钟频率读
 * 成 0，cpufreq-dt 随之注册失败：
 *
 *	cpufreq: cpufreq_policy_online: ->get() failed
 *	cpufreq-dt cpufreq-dt: failed register driver: -19
 *
 * 结果是 CPU 恒定停在引导程序设定的频率，且因为 cpufreq 的散热设备没注册，
 * cpu-thermal 那个 95°C 的被动降频档位没有任何东西可以执行。
 *
 * patches-6.18/608 给驱动加了直接编程 ARMPLL 的回退路径，这里把它需要的两
 * 段寄存器补上。驱动会先探测 SMC，只有在 SMC 无响应时才用这两段，所以对
 * ATF 正常的板子没有影响。
 */
&cpufreq {
	reg = <0x0 0x1fa20000 0x0 0x2c0>,	/* chip-scu */
	      <0x0 0x1efbe000 0x0 0x800>;	/* mcucfg */
	reg-names = "chip-scu", "mcucfg";
};
